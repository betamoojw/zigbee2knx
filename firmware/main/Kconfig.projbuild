## firmware/main/Kconfig.projbuild
```kconfig
menu "zigbee2knx"

config Z2K_BOARD_TULX32
    bool "TULX32: button S1 on GPIO14, console on UART0, the frozen partition table of the TULX32 as shipped"
    default n
    help
        Builds for the TULX32 (main/board.h): records and templates in actor_db, Zigbee in the shared nvs, which
        this firmware then never erases. Set by sdkconfig.tulx.

config Z2K_TRUST_DEV_KEY
    bool "Also trust the development key for embedded templates"
    default n
    help
        Templates signed with the development key (fingerprint 91a09904f3083dc6) load as well as those signed with
        the release key. For development builds only; the project's firmware images are built without it.

endmenu
```
